## Closed_source/QSemOS/src/arch/cpu/Kconfig
```kconfig
choice
	prompt "Platform Setup"
config OS_ARCH_ARMV7_M
	bool "ARMV7_M"
config OS_ARCH_X86_64
	bool "X86_64"
config OS_ARCH_RISCV64
	bool "RISCV64"
config OS_ARCH_ARMV7_R
	bool "ARMV7_R"
endchoice

source "arch/cpu/riscv64/Kconfig"
source "arch/cpu/armv7-m/Kconfig"
source "arch/cpu/x86_64/Kconfig"
source "arch/cpu/armv7-r/Kconfig"
```

## Closed_source/QSemOS/src/arch/cpu/armv7-r/Kconfig
```kconfig
menu "ARM7-M Sepecfic Configuration"

depends on OS_ARCH_ARMV7_R

config INTERNAL_OS_D9_SECURE
	bool
	select INTERNAL_OS_BYTE_ORDER_LE

choice
	prompt "Cpu Type"

config INTERNAL_OS_PLATFORM_CORTEX_R5
	bool "CORTEX_R5"
	select INTERNAL_OS_D9_SECURE

endchoice

endmenu
```
